## conf/layer.conf
```bitbake
BBPATH := "${BBPATH}:${LAYERDIR}" 
# We have a packages directory, add to BBFILES 
BBFILES := "${BBFILES} ${LAYERDIR}/recipes-*/*/*.bb \ 
           ${LAYERDIR}/recipes-*/*/*.bbappend" 
BBFILE_COLLECTIONS += "longship" 
BBFILE_PATTERN_longship := "^${LAYERDIR}/" 
BBFILE_PRIORITY_longship := "5"
```
